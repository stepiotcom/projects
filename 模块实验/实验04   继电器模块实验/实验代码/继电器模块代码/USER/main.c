#include "stm32f1xx_hal.h"
#include "stm32f1xx.h"
#include "delay.h"
#include "Usart.h"
#include "Relay.h"
#include "Rs485.h"	

/**
************************************************************
************************************************************
************************************************************
*
*	作者： 		重庆八城科技
*
*	日期： 		2018-01-01
*
*	版本： 		V1.0
*
*	说明： 		继电器库函数操作实验-HAL库版本
*
*	修改记录：	
************************************************************
************************************************************
************************************************************
**/


int main(void)
{ 
	uint8_t fag = 0;  								//接收数据
	
  HAL_Init();             					//初始化HAL库  
	UART1_Init(115200);								//初始化串口
	Relay_Init();   									//初始化继电器
	Rs485_Init();   									//初始化485


	while(1)
	{
		fag = USART1_IRQHand(); //等待接收总线数据 返回一个标志位
		
		if(fag == 1)
		{
			/*		密码正确		*/
			Relay_Config(1);  //开启继电器
		}
		else if(fag == 2)
		{
			/*		密码错误		*/
			Relay_Config(0);  //关闭继电器
		}
		else
		{
			Relay_Config(0);  //关闭继电器
		}	
	}
}

