#include "stm32f1xx_hal.h"
#include "stm32f1xx.h"
#include "delay.h"
#include "Usart.h"
#include "Rs485.h"	
#include "pwm.h"

/**
************************************************************
************************************************************
************************************************************
*
*	作者： 		重庆八城科技
*
*	日期： 		2018-01-01
*
*	版本： 		V1.0
*
*	说明： 		风扇库函数操作实验-HAL库版本
*
*	修改记录：	
************************************************************
************************************************************
************************************************************
**/


int main(void)
{ 
	uint8_t fag = 0;  								//接收数据
	
  HAL_Init();             					//初始化HAL库  
	UART1_Init(115200);								//初始化串口
	Rs485_Init();   									//初始化485
  TIM4_PWM_Init(64-1,20000-1);			//初始化定时器

	while(1)
	{
		
		fag = USART1_IRQHand(); 				//等待接收总线数据
		
		if(fag == 0)										//停止
		{
				PWM_SetTIM4Compare2(20000);	//停止
		}
		else if(fag == 1)								//一档
		{
				PWM_SetTIM4Compare2(11000); //一档
			
		}else if(fag == 2)							//二档
		{
				PWM_SetTIM4Compare2(9000);  //二档
		
		}else if(fag == 3)							//三档
		{
				PWM_SetTIM4Compare2(10);  	//三档
		}
		 
	}
}

